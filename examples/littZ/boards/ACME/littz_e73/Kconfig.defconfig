## examples/littZ/boards/ACME/littz_e73/Kconfig.defconfig
```kconfig
if BOARD_LITTZ_E73

config BOARD_ENABLE_DCDC
	bool "DCDC mode"
	select SOC_DCDC_NRF52X
	default y

config BT_CTLR
	default BT

endif # BOARD_LITTZ_E73

if USB_DEVICE_STACK

config UART_CONSOLE
	default CONSOLE

config USB_DEVICE_INITIALIZE_AT_BOOT
	default y

endif # USB_DEVICE_STACK
```

## examples/littZ/boards/ACME/littz_e73/littz_e73_defconfig
```kconfig
# CONFIG_SOC_SERIES_NRF52X=y
# CONFIG_SOC_NRF52840_QIAA=y

CONFIG_ARM_MPU=y
CONFIG_HW_STACK_PROTECTION=y

CONFIG_USB_DEVICE_STACK=y

# Build UF2 by default, supported by the Adafruit nRF52 Bootloader
# CONFIG_BUILD_OUTPUT_UF2=y
# CONFIG_USE_DT_CODE_PARTITION=y

CONFIG_GPIO_AS_PINRESET=n
CONFIG_PINCTRL=y

CONFIG_CLOCK_CONTROL_NRF_K32SRC_SYNTH=y
# CONFIG_CLOCK_CONTROL_NRF_CALIBRATION_LF_ALWAYS_ON=y
```

## examples/littZ/sample.yaml
```yaml
sample:
  description: littZ
    application
  name: littZ
common:
    tags: introduction
    integration_platforms:
      - native_posix
    harness: console
    harness_config:
      type: one_line
      regex:
        - "Hello World! (.*)"
tests:
  sample.basic.helloworld:
    tags: introduction
```
